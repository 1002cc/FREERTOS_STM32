#include "menu.h"   

const unsigned char col[] U8X8_PROGMEM = { 0x00,0x00,0x00,0x3e,0x00,0x00,0x00,0x00,0x80,0x7f,0x00,0x00,0x00,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0x00,0x00 };

const unsigned char co2[] U8X8_PROGMEM = { 0x00,0x00,0x80,0x01,0x00,0x00,0x00,0x00,0x80,0x01,0x00,0x00,0x00,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0xff,0x3f };

const unsigned char co3[] U8X8_PROGMEM = { 0x00,0x00,0x00,0x00,0x00,0x00,0x00,0x00,0x00,0x00,0x00,0x00,0x00,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0x00,0x00 };

const unsigned char co4[] U8X8_PROGMEM = { 0x00,0x00,0x00,0x00,0x00,0x00,0x00,0x00,0x00,0x00,0x00,0x00,0x00,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0x00,0x00 };
	
const unsigned char co5[] U8X8_PROGMEM = { 0x00,0x00,0x00,0x00,0x00,0x00,0x00,0x00,0x00,0x00,0x00,0x00,0x00,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0x00,0x00 };

const unsigned char co6[] U8X8_PROGMEM = { 0x00,0x00,0x00,0x00,0x00,0x00,0x00,0x00,0x00,0x00,0x00,0x00,0x00,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0x00,0x00 };

const unsigned char alarm[] U8X8_PROGMEM = { 0x00,0x00,0x00,0x00,0x00,0x00,0x00,0x00,0x00,0x00,0x00,0x00,0x00,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0x00,0x00 };
	
const unsigned char cot[] U8X8_PROGMEM = { 0x00,0x00,0x00,0x00,0x00,0x00,0x00,0x00,0x00,0x00,0x00,0x00,0x00,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0x00,0x00 };
	
const unsigned char wifi[] U8X8_PROGMEM = { 0x00,0x00,0x00,0x00,0x00,0x00,0x00,0x00,0x00,0x00,0x00,0x00,0x00,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0x00,0x00 };

	
extern TaskHandle_t RTC_Handler;	
extern TaskHandle_t DHT11_DATA_Handler;	
extern TaskHandle_t ADC_DATA_Handler;
extern TaskHandle_t LIGTH_DATA_Handler;
extern TaskHandle_t SG_HC_MONITOR_Handler;
extern TaskHandle_t KEY4x4_PRO_Handler;
extern TaskHandle_t KEY4x4_Handler;
extern TaskHandle_t  MQTT_ESP_Handler;
/*多级菜单*/
Menu_table table[30]=
{
    {0,0,0,1,0,(*home)},				//一级界面（主页面） 索引，向下一个，确定，退出
		
    {1,7,2,8,0,(*Temperature)},			//二级界面 温湿度
    {2,1,3,9,0,(*Palygame)},	
    {3,2,4,10,0,(*Ligthset)},	
    {4,3,5,11,0,(*Monitor)},	
	{5,4,6,12,0,(*Unlock)},	
	{6,5,7,13,0,(*Esp_Mqtt)},	
	{7,6,1,14,0,(*Info)},	
	 
	{8,1,1,0,1,(*TestTemperature)},		//三级界面：DHT11测量温湿度
	{9,2,2,0,2,(*ConrtolGame)},				
	{10,3,3,0,3,(*Ledset)},						
	{11,4,4,0,4,(*Set)},
	{12,5,5,0,5,(*UnlockSet)},
	{13,6,6,0,6,(*MQTTSet)},
	{14,7,7,0,7,(*Information)},		//三级界面：作者和相关项目信息
};



void home(void)
{
	if(eTaskGetState(RTC_Handler)==eSuspended)
	{
		vTaskResume(RTC_Handler); //显示时间
	}	
}
 
void Temperature(void)
{
	u8g2_ClearBuffer(&u8g2); 
	u8g2_DrawStr(&u8g2,10,30,"<");
	u8g2_DrawXBMP(&u8g2,40,10,48,48,col);
	u8g2_DrawStr(&u8g2,110,30,">");
	u8g2_SendBuffer(&u8g2);
}
 
void Palygame(void)
{
	u8g2_ClearBuffer(&u8g2); 
	u8g2_DrawStr(&u8g2,10,30,"<");
	u8g2_DrawXBMP(&u8g2,40,10,48,48,co2);
	u8g2_DrawStr(&u8g2,110,30,">");
	u8g2_SendBuffer(&u8g2);
}
 
void Monitor(void)
{
	u8g2_ClearBuffer(&u8g2); 
	u8g2_DrawStr(&u8g2,10,30,"<");
	u8g2_DrawXBMP(&u8g2,40,10,48,48,co6);
	u8g2_DrawStr(&u8g2,110,30,">");
	u8g2_SendBuffer(&u8g2);
}

void Ligthset(void)
{
	u8g2_ClearBuffer(&u8g2); 
	u8g2_DrawStr(&u8g2,10,30,"<");
	u8g2_DrawXBMP(&u8g2,40,10,48,48,co4);
	u8g2_DrawStr(&u8g2,110,30,">");
	u8g2_SendBuffer(&u8g2);
}

void Esp_Mqtt(void)
{
	u8g2_ClearBuffer(&u8g2); 
	u8g2_DrawStr(&u8g2,10,30,"<");
	u8g2_DrawXBMP(&u8g2,40,10,48,48,wifi);
	u8g2_DrawStr(&u8g2,110,30,">");
	u8g2_SendBuffer(&u8g2);
}

void Unlock(void)
{
	u8g2_ClearBuffer(&u8g2); 
	u8g2_DrawStr(&u8g2,10,30,"<");
	u8g2_DrawXBMP(&u8g2,40,10,48,48,cot);
	u8g2_DrawStr(&u8g2,110,30,">");
	u8g2_SendBuffer(&u8g2);
}


void Info(void)
{
	u8g2_ClearBuffer(&u8g2); 
	u8g2_DrawStr(&u8g2,10,30,"<");
	u8g2_DrawXBMP(&u8g2,40,10,48,48,co5);
	u8g2_DrawStr(&u8g2,110,30,">");
	u8g2_SendBuffer(&u8g2);
}



void TestTemperature(void)
{
	if(eTaskGetState(DHT11_DATA_Handler)==eSuspended)
	{
		vTaskResume(DHT11_DATA_Handler);
	}
}
 
void ConrtolGame(void)
{
	if(eTaskGetState(ADC_DATA_Handler)==eSuspended)
	{
		vTaskResume(ADC_DATA_Handler);
	}
}


void Ledset(void)
{
	if(eTaskGetState(LIGTH_DATA_Handler)==eSuspended)
	{
		vTaskResume(LIGTH_DATA_Handler);
	}
}

void Set(void)
{
	if(eTaskGetState(SG_HC_MONITOR_Handler)==eSuspended)
	{
		vTaskResume(SG_HC_MONITOR_Handler);
	}
}

void MQTTSet(void)
{
	if(eTaskGetState(MQTT_ESP_Handler)==eSuspended)
	{
		vTaskResume(MQTT_ESP_Handler);
	}
}


void UnlockSet(void)
{
	if(eTaskGetState(KEY4x4_Handler)==eSuspended)
	{
		vTaskResume(KEY4x4_Handler);
	}
	if(eTaskGetState(KEY4x4_PRO_Handler)==eSuspended)
	{
		vTaskResume(KEY4x4_PRO_Handler);
	}
}

void Information(void)
{
	u8g2_DrawStr(&u8g2, 20, 25, "NULL");
}
 
